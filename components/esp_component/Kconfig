## components/esp_component/Kconfig
```kconfig
menu "esp_component"

	config ESP_COMPONENT_MAX
		int "Maximum number of rotary encoders"
		default 1
			
	config ESP_COMPONENT_INTERVAL_US
		int "Polling interval, us"
		default 1000
		
	config ESP_COMPONENT_BTN_DEAD_TIME_US
		int "Button dead time, us"
		default 10000
			
	choice ESP_COMPONENT_BTN_PRESSED_LEVEL
		prompt "Logical level on pressed button"
		config ESP_COMPONENT_BTN_PRESSED_LEVEL_0
			bool "0"
		config ESP_COMPONENT_BTN_PRESSED_LEVEL_1
			bool "1"
	endchoice
	
	config ESP_COMPONENT_BTN_LONG_PRESS_TIME_US
		int "Long press timeout, us"
		default 500000

endmenu
```

## components/i2cbus/Kconfig
```kconfig
menu "I2CBUS"

    config I2C_MASTER_SCL
        int "SCL GPIO Num"
        default 6 if IDF_TARGET_ESP32C3
        default 19 if IDF_TARGET_ESP32 || IDF_TARGET_ESP32S2 || IDF_TARGET_ESP32S3
        help
            GPIO number for I2C Master clock line.

    config I2C_MASTER_SDA
        int "SDA GPIO Num"
        default 5 if IDF_TARGET_ESP32C3
        default 18 if IDF_TARGET_ESP32 || IDF_TARGET_ESP32S2 || IDF_TARGET_ESP32S3
        help
            GPIO number for I2C Master data line.
    
    choice I2C_MASTER_FREQ
        prompt "I2C frequency mode"
        default I2C_MASTER_FREQ_STANDARD_MODE
        help
            Select i2c bus frequency
        
        config I2C_MASTER_FREQ_STANDARD_MODE
            bool "Standart-mode 100 kbit/s"
        config I2C_MASTER_FREQ_FAST_MODE
            bool "Fast-mode 400 kbit/s"
        config I2C_MASTER_FREQ_FAST_MODE_PLUS
            bool "Fast-mode Plus 1 Mbit/s"
    endchoice
    
    config I2C_MASTER_FREQ
        int 
        default 100000  if I2C_MASTER_FREQ_STANDARD_MODE
        default 400000  if I2C_MASTER_FREQ_FAST_MODE
        default 100000000  if I2C_MASTER_FREQ_FAST_MODE_PLUS
            
    config I2C_TIMEOUT
        int "I2C transaction timeout, milliseconds"
        default 250
        range 10 5000
    
endmenu
```

## components/lcd_i2c/Kconfig
```kconfig
menu "LCD_I2C"
	config LCD_OUTPUT_ENABLE
        bool "Enable LCD output."
        help
            Select this if your board has a LCD.
    
	config LCD_ADDRESS
        depends on LCD_OUTPUT_ENABLE
		hex "I2C address of lcd based on PCF8574A"
        range 0x38 0x3F
		default 0x3F
        help
            Time (in seconds) after which the Wi-Fi provisioning manager will auto-stop after connecting to
            a Wi-Fi network successfully.

	config LCD_MAX_NUM
		int "Maximum number of lcd displays"
		default 1
	
	# config LCD_TIMEOUT
	# 	prompt "Timeout to consider lcd disconected from i2cbus (ms)"
	# 	default 200
    #     range 200 1000

    config LCD_TIMEOUT
        depends on LCD_OUTPUT_ENABLE
        int "Timeout to consider lcd disconected from i2cbus (ms)"
        range 100 1500
        default 1000
        help
            Define the max period to lcd answare in milliseconds.

endmenu
```
